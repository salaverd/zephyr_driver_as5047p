## Kconfig
```kconfig
# SPDX-License-Identifier: Apache-2.0
#
# Copyright (c) 2024 Intel


config AMS_AS5047P
	bool "AS5047P Angular position sensor"
	default y
	depends on DT_HAS_AMS_AS5047P_ENABLED
	select SPI
	help
	  Enable driver for AS5047P Angular position sensor.
```

## dts/bindings/sensor/ams,as5047p.yaml
```yaml
# SPDX-License-Identifier: Apache-2.0
# Copyright (c) 2023 Linumiz

description: |
    AMS (Austria Mikro Systeme) AS5047P Angular position sensor

compatible: "ams,as5047p"

include: [sensor-device.yaml, spi-device.yaml]
```
